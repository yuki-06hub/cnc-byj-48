// generated by mBlock5 for <your product>
// codes make you happy

#include <Servo.h>
#include <Arduino.h>
#include <Wire.h>
#include <SoftwareSerial.h>
#include "src/X113647Stepper.h"

float x_endstop_value = 0;
float y_endstop_value = 0;
float home = 0;
float xmax = 0;
float ymax = 0;
float ciblex = 0;
float cibley = 0;
float pos_x = 0;
float pos_y = 0;

void rgb_y(){
  analogWrite(2,255);
  analogWrite(3,120);
  analogWrite(4,0);

}
void rgb_w(){
  analogWrite(2,255);
  analogWrite(3,255);
  analogWrite(4,255);

}
void rgb_off(){
  analogWrite(2,0);
  analogWrite(3,0);
  analogWrite(4,0);

}
void rgb_r(){
  analogWrite(2,255);
  analogWrite(3,0);
  analogWrite(4,0);

}
void rgb_g(){
  analogWrite(2,0);
  analogWrite(3,255);
  analogWrite(4,0);

}
Servo servo_22;
void pendozn(){
  servo_22.write(80);
  _delay(1);

}
void penup(){
  servo_22.write(120);
  _delay(1);

}
void crit_errror(){
  while(1) {
      rgb_off();
      _delay(0.5);
      tone(11,82,0.25*1000);
      delay(0.25*1000);
      rgb_r();
      _delay(0.5);

      _loop();
  }

}
X113647Stepper stepMotor_1(2048, 36, 34, 32, 30);

X113647Stepper stepMotor_2(2048, 46, 44, 42, 40);

void goto_(){
  rgb_y();
  tone(11,262,0.25*1000);
  delay(0.25*1000);
  tone(11,87,0.25*1000);
  delay(0.25*1000);
  tone(11,131,0.25*1000);
  delay(0.25*1000);
  if(pos_x < ciblex){
    while(!(pos_x == ciblex))
    {
      _loop();
      stepMotor_1.step(-10);
      pos_x += 10;

    }

  }
  if(pos_x > ciblex){
    while(!(pos_x == ciblex))
    {
      _loop();
      stepMotor_1.step(10);
      pos_x += -10;

    }

  }
  if(pos_x == ciblex){

  }
  tone(11,262,0.25*1000);
  delay(0.25*1000);
  tone(11,87,0.25*1000);
  delay(0.25*1000);
  tone(11,131,0.25*1000);
  delay(0.25*1000);
  if(pos_y < cibley){
    while(!(pos_y == cibley))
    {
      _loop();
      stepMotor_2.step(10);
      pos_y += 10;

    }

  }
  if(pos_y > cibley){
    while(!(pos_y == cibley))
    {
      _loop();
      stepMotor_2.step(-10);
      pos_y += -10;

    }

  }
  if(pos_y == ciblex){

  }
  tone(11,262,0.25*1000);
  delay(0.25*1000);
  tone(11,87,0.25*1000);
  delay(0.25*1000);
  tone(11,131,0.25*1000);
  delay(0.25*1000);

}

void _delay(float seconds) {
  long endTime = millis() + seconds * 1000;
  while(millis() < endTime) _loop();
}

void setup() {
  pinMode(2,OUTPUT);
  pinMode(3,OUTPUT);
  pinMode(4,OUTPUT);
  servo_22.attach(22);
  pinMode(11,OUTPUT);
  stepMotor_1.setSpeed(6);
  stepMotor_2.setSpeed(6);
  pinMode(50,INPUT);
  pinMode(51,INPUT);
  penup();
  rgb_w();
  xmax = 1430;
  ymax = 1095;
  y_endstop_value = -10;
  x_endstop_value = 10;
  home = 0;
  tone(11,1760,0.1*1000);
  delay(0.1*1000);
  stepMotor_1.step(-100);
  stepMotor_2.step(100);
  _delay(1);
  while(!(digitalRead(50) == 0.000000))
  {
    _loop();
    stepMotor_1.step(x_endstop_value);

  }
  home += 0.5;
  _delay(1);
  while(!(digitalRead(51) == 0.000000))
  {
    _loop();
    stepMotor_2.step(y_endstop_value);

  }
  home += 0.5;
  if(home < 1.1){
    rgb_g();
    pos_x = 0;
    pos_y = 0;
    tone(11,1976,0.25*1000);
    delay(0.25*1000);

  }
  _delay(1);
  tone(11,262,0.25*1000);
  delay(0.25*1000);
  ciblex = 2000;
  cibley = 4000;
  goto_();
  pendozn();
  ciblex = 5000;
  cibley = 8000;
  goto_();
  penup();
  ciblex = 100;
  cibley = 100;
  goto_();

}

void _loop() {
}

void loop() {
  _loop();
}

